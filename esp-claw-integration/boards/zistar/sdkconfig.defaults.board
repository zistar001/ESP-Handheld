## esp-claw-integration/boards/zistar/sdkconfig.defaults.board
```kconfig
# Zistar ESP-Handheld: 16 MB DIO flash @ 80 MHz + 8 MB octal PSRAM
CONFIG_ESP_DEFAULT_CPU_FREQ_MHZ_240=y

CONFIG_ESPTOOLPY_FLASHMODE_DIO=y
CONFIG_ESPTOOLPY_FLASHFREQ_80M=y
CONFIG_ESPTOOLPY_FLASHSIZE_16MB=y

CONFIG_PARTITION_TABLE_CUSTOM=y
CONFIG_PARTITION_TABLE_CUSTOM_FILENAME="partitions_16MB.csv"
CONFIG_PARTITION_TABLE_OFFSET=0x8000

CONFIG_SPIRAM=y
CONFIG_SPIRAM_MODE_OCT=y
CONFIG_SPIRAM_SPEED_80M=y

# Speaker: internal/dummy codec over I2S TX -> MAX98357
CONFIG_CODEC_DUMMY_SUPPORT=y
CONFIG_CODEC_DATA_ADC_SUPPORT=y
CONFIG_ESP_BOARD_PERIPH_I2S_SUPPORT=y

# Display
CONFIG_ESP_BOARD_DEV_DISPLAY_LCD_SUPPORT=y

# USB: Serial JTAG (UART0 is used for external serial on this board)
CONFIG_ESP_CONSOLE_UART=y
CONFIG_ESP_CONSOLE_UART_NUM=0
CONFIG_ESP_CONSOLE_SECONDARY_USB_SERIAL_JTAG=y

# Enable emote for facial expressions
CONFIG_APP_CLAW_ENABLE_EMOTE=y
```

## main/Kconfig.projbuild
```kconfig
# ESP-Handheld Configuration
# ==========================
# Set your API keys and device preferences here.
# Run: idf.py menuconfig → "ESP-Handheld Configuration"

menu "ESP-Handheld Configuration"

    config WEATHER_API_KEY
        string "HeFeng Weather API Key"
        default ""
        help
            和风天气 (devapi.qweather.com) API 密钥。
            注册地址: https://devapi.qweather.com
            留空则天气功能自动禁用。
            You can also set this at runtime via 'weather_set_api_key()'.

    config WEATHER_DEFAULT_LOCATION
        string "Default Weather Location ID"
        default "101230501"
        help
            和风天气城市 ID。默认 101230501 (泉州)。
            可在设备 Settings → 天气地区 中修改。

    config BLE_DEVICE_NAME
        string "Bluetooth Device Name"
        default "ESP-Handheld"
        help
            BLE HID 广播名称，其他设备搜索时显示此名称。

    config WIFI_AP_SSID_PREFIX
        string "WiFi AP SSID Prefix"
        default "ESP-Handheld"
        help
            配置模式下 WiFi 热点 SSID 前缀。

endmenu
```

## retro-go-firmware/sdkconfig.defaults
```kconfig
# retro-go-firmware sdkconfig.defaults
# Target: ESP32-S3, 16MB flash, 8MB PSRAM

CONFIG_IDF_TARGET="esp32s3"
CONFIG_ESP_DEFAULT_CPU_FREQ_MHZ_240=y
CONFIG_ESPTOOLPY_FLASHSIZE_16MB=y

# Use custom partition table with 4MB app partition
CONFIG_PARTITION_TABLE_CUSTOM=y
CONFIG_PARTITION_TABLE_CUSTOM_FILENAME="partitions_4mb.csv"
CONFIG_PARTITION_TABLE_OFFSET=0x8000

# PSRAM config (MUST be caps alloc, not malloc, for DMA safety)
CONFIG_SPIRAM=y
CONFIG_SPIRAM_MODE_OCT=y
CONFIG_SPIRAM_TYPE_AUTO=y
CONFIG_SPIRAM_USE_CAPS_ALLOC=y
CONFIG_SPIRAM_IGNORE_NOTFOUND=y
CONFIG_SPIRAM_MEMTEST=n
CONFIG_SPIRAM_TRY_ALLOCATE_WIFI_LWIP=y

# mbedTLS memory optimization
CONFIG_MBEDTLS_EXTERNAL_MEM_ALLOC=y
CONFIG_MBEDTLS_DYNAMIC_BUFFER=y

# WiFi memory tuning
CONFIG_ESP_WIFI_STATIC_RX_BUFFER_NUM=3
CONFIG_ESP_WIFI_DYNAMIC_RX_BUFFER_NUM=6
CONFIG_ESP_WIFI_RX_BA_WIN=3

# Tick rate
CONFIG_FREERTOS_HZ=1000

# System event stack
CONFIG_ESP_SYSTEM_EVENT_TASK_STACK_SIZE=4096

# FATFS LFN support
CONFIG_FATFS_LFN_STACK=y

# Compiler optimizations
CONFIG_COMPILER_OPTIMIZATION_PERF=y
```

## sdkconfig.defaults
```kconfig
CONFIG_IDF_TARGET="esp32s3"
CONFIG_ESP32S3_DEFAULT_CPU_FREQ_240=y
CONFIG_ESPTOOLPY_FLASHSIZE_16MB=y
CONFIG_PARTITION_TABLE_CUSTOM=y
CONFIG_PARTITION_TABLE_CUSTOM_FILENAME="partitions.csv"
CONFIG_SPIRAM=y
CONFIG_SPIRAM_MODE_OCT=y
CONFIG_SPIRAM_TYPE_AUTO=y
CONFIG_SPIRAM_USE_CAPS_ALLOC=y
CONFIG_SPIRAM_IGNORE_NOTFOUND=y
CONFIG_FATFS_LFN_STACK=y
# Codec
CONFIG_CODEC_ES8311_SUPPORT=y
CONFIG_CODEC_ES7210_SUPPORT=y
# Power management: enable DFS (Dynamic Frequency Scaling)
# CONFIG_PM_ENABLE is not set
# SNTP: allow 2 NTP server entries for redundancy
CONFIG_LWIP_SNTP_MAX_SERVERS=2
# Sleep config
CONFIG_ESP_SLEEP_FLASH_LEAKAGE_WORKAROUND=y
# Component manager disabled (offline build)
# CONFIG_IDF_COMPONENT_MANAGER is set via environment variable in build.bat

# USB Serial/JTAG: GPIO19(D-) GPIO20(D+)
# SD卡CS: GPIO18 (不冲突)

# LVGL: use lv_conf.h instead of Kconfig
# CONFIG_LV_CONF_SKIP is not set
# CONFIG_LV_BUILD_EXAMPLES is not set

# Disable idle task WDT on CPU0 — NES emulator starves idle_0 by design
CONFIG_ESP_TASK_WDT_CHECK_IDLE_TASK_CPU0=n
CONFIG_ESP_TASK_WDT_CHECK_IDLE_TASK_CPU1=n

# Memory allocation — reserve internal SRAM for DMA (xiaozhi-derived)
CONFIG_SPIRAM_MEMTEST=n
CONFIG_MBEDTLS_EXTERNAL_MEM_ALLOC=y
CONFIG_MBEDTLS_DYNAMIC_FREE_CONFIG_DATA=y
# Let mbedTLS IO buffers allocate from PSRAM (key for SSL memory)
CONFIG_MBEDTLS_DYNAMIC_BUFFER=y
# Free CA cert after verification
CONFIG_MBEDTLS_DYNAMIC_FREE_CA_CERT=y
# Don't keep peer certificate after TLS handshake
CONFIG_MBEDTLS_SSL_KEEP_PEER_CERTIFICATE=n

# WiFi memory optimization (xiaozhi-derived)
CONFIG_ESP_WIFI_STATIC_RX_BUFFER_NUM=3
CONFIG_ESP_WIFI_DYNAMIC_RX_BUFFER_NUM=6
CONFIG_ESP_WIFI_RX_BA_WIN=3
CONFIG_LWIP_TCPIP_RECVMBOX_SIZE=16

# Increase tick rate for precise frame timing (1000Hz=1ms tick, was 100Hz)
CONFIG_FREERTOS_HZ=1000

# System event task stack — WiFi event handlers need more than 2304
CONFIG_ESP_SYSTEM_EVENT_TASK_STACK_SIZE=4096
CONFIG_SYSTEM_EVENT_TASK_STACK_SIZE=4096

# LVGL: byte-swap RGB565 for ST7789 SPI (MSB-first)
CONFIG_LV_COLOR_16_SWAP=y
# LVGL memory pool
CONFIG_LV_MEM_SIZE_KILOBYTES=64

# Bluetooth / BLE HID
CONFIG_BT_ENABLED=y
CONFIG_BT_BLUEDROID_ENABLED=y
CONFIG_BT_CONTROLLER_ENABLED=y
CONFIG_BTDM_CTRL_MODE_BLE_ONLY=y
CONFIG_BTDM_CTRL_HCI_MODE_VHCI=y
CONFIG_BTDM_CTRL_BLE_MAX_CONN=1
CONFIG_BT_ALLOCATION_FROM_SPIRAM_FIRST=y
CONFIG_BT_BLE_DYNAMIC_ENV_MEMORY=y
# BLE 4.2 features needed for GAP advertising API (HID requires it)
CONFIG_BT_BLE_42_FEATURES_SUPPORTED=y
# BLE 5.0 and 4.2 cannot coexist; 4.2 is sufficient for HID
# CONFIG_BT_BLE_50_FEATURES_SUPPORTED is not set

# WiFi allocation from PSRAM to save internal DRAM
CONFIG_SPIRAM_TRY_ALLOCATE_WIFI_LWIP=y
```

## xiaozhi-esp32-main/sdkconfig.defaults.gezipai
```kconfig
CONFIG_BOARD_TYPE_GEZIPAI=y
CONFIG_PARTITION_TABLE_CUSTOM_FILENAME="partitions/gezipai/16m_dualsystem.csv"
```
